/* DO NOT EDIT!
   This file was automatically generated by multigen
   from driver.def  */

MEMORY
{
	editfnsres : ORIGIN = 0x0, LENGTH = 32768
}

SECTIONS
{
	editfns : { *(editfns) } > editfnsres
}
